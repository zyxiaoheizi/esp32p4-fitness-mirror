## main/Kconfig.projbuild
```kconfig
menu "Video Configuration"

    config EXAMPLE_ENABLE_MIPI_CSI_CAM_SENSOR
        bool "Enable MIPI CSI Camera Sensor"
        default y
        depends on SOC_MIPI_CSI_SUPPORTED

    if EXAMPLE_ENABLE_MIPI_CSI_CAM_SENSOR
        config EXAMPLE_MIPI_CSI_SCCB_I2C_PORT
            int "MIPI CSI SCCB I2C Port Number"
            default 0
            range 0 1

        config EXAMPLE_MIPI_CSI_SCCB_I2C_SCL_PIN
            int "MIPI CSI SCCB I2C SCL Pin"
            default 8
            range -1 56

        config EXAMPLE_MIPI_CSI_SCCB_I2C_SDA_PIN
            int "MIPI CSI SCCB I2C SDA Pin"
            default 7
            range -1 56

        config EXAMPLE_MIPI_CSI_SCCB_I2C_FREQ
            int "MIPI CSI SCCB I2C Frequency"
            default 100000
            range 100000 400000
            help
                Increasing this value can reduce the initialization time of the camera sensor.
                Please refer to the relevant instructions of the camera sensor to adjust the value.

        config EXAMPLE_MIPI_CSI_CAM_SENSOR_RESET_PIN
            int "MIPI CSI Camera Sensor Reset Pin"
            default -1
            range -1 56

        config EXAMPLE_MIPI_CSI_CAM_SENSOR_PWDN_PIN
            int "MIPI CSI Camera Sensor Power Down Pin"
            default -1
            range -1 56
    endif

    config EXAMPLE_ENABLE_PRINT_FPS_RATE_VALUE
        bool "enable print fps rate value"
        default y

    config EXAMPLE_ENABLE_CAM_SENSOR_PIC_VFLIP
        bool "Enable Camera Sensor Picture Vertical Flip"
        default y
        help
            Select this option, enable camera sensor picture vertical flip.

    config EXAMPLE_ENABLE_CAM_SENSOR_PIC_HFLIP
        bool "Enable Camera Sensor Picture Horizontal Flip"
        default y
        help
            Select this option, enable camera sensor picture horizontal flip.

endmenu

menu "PC Pose"
    config PC_POSE_ENABLE
        bool "Enable PC-side pose estimation"
        default y
        help
            Send a resized RGB565 frame to a PC TCP service and draw returned
            33-point pose landmarks on the board.

    config PC_POSE_WIFI_SSID
        string "Wi-Fi SSID for PC pose"
        default "zyntm"

    config PC_POSE_WIFI_PASSWORD
        string "Wi-Fi password for PC pose"
        default "ZY616161"

    config PC_POSE_SERVER_URL
        string "PC pose server URL"
        default "http://192.168.1.100:8000/pose"
        help
            Legacy HTTP URL. The fast path uses PC_POSE_SERVER_HOST and PC_POSE_SERVER_PORT.

    config PC_POSE_SERVER_HOST
        string "PC pose server host"
        default "192.168.43.131"
        help
            PC LAN IPv4 address running tools/pc_pose_server/server.py.

    config PC_POSE_SERVER_PORT
        int "PC pose TCP server port"
        default 8000
        range 1 65535

    config PC_POSE_FRAME_W
        int "PC pose upload width"
        default 320
        range 96 640

    config PC_POSE_FRAME_H
        int "PC pose upload height"
        default 240
        range 96 480

    config PC_POSE_HTTP_TIMEOUT_MS
        int "PC pose TCP timeout in ms"
        default 2500
        range 500 10000

    config PC_POSE_WIFI_CONNECT_TIMEOUT_MS
        int "PC pose Wi-Fi connect wait in ms"
        default 10000
        range 1000 60000

    config PC_POSE_WIFI_MAX_RETRY
        int "PC pose Wi-Fi retry count"
        default 8
        range 1 50

    config PC_POSE_RESPONSE_MAX_BYTES
        int "PC pose response buffer bytes"
        default 16384
        range 4096 65536
endmenu

menu "UI display rotation"
    choice APP_UI_DISP_ROTATION
        prompt "LVGL display rotation (physical panel upside-down)"
        default APP_UI_DISP_ROT_180
        help
            Match the official 11_esp_brookesia_phone example for the
            ESP32-P4-WIFI6-Touch-LCD-7B kit.

        config APP_UI_DISP_ROT_0
            bool "0 deg (no rotation)"
        config APP_UI_DISP_ROT_180
            bool "180 deg"
    endchoice
endmenu

menu "Camera Sensor (Waveshare ESP32-P4-WIFI6-Touch-LCD-7B)"
    choice CAMERA_SENSOR_MODEL
        prompt "Camera sensor model"
        default CAMERA_SENSOR_OV5647
        help
            Your board uses OV5647 MIPI CSI camera.
            Reference the working code from 11_esp_brookesia_phone/components/apps/camera/
            and the parent's app_video / pipeline implementation.

        config CAMERA_SENSOR_OV5647
            bool "OV5647 (MIPI CSI)"
        config CAMERA_SENSOR_SC2336
            bool "SC2336 (MIPI CSI, fallback)"
        config CAMERA_SENSOR_NONE
            bool "No camera / Custom"
    endchoice
endmenu

menu "Face DB (human_face_recognition example)"
    choice DB_FILE_SYSTEM
        prompt "database file system"
        default DB_SPIFFS
        config DB_FATFS_FLASH
            bool "fatfs_flash"
        config DB_FATFS_SDCARD
            bool "fatfs_sdcard"
        config DB_SPIFFS
            bool "spiffs"
    endchoice

    config DB_FILE_SYSTEM
        int
        default 0 if DB_FATFS_FLASH
        default 1 if DB_FATFS_SDCARD
        default 2 if DB_SPIFFS
endmenu
```

## sdkconfig.defaults
```kconfig
# Align camera / video / P4 options with 11_esp_brookesia_phone (sdkconfig.defaults)
CONFIG_IDF_TARGET="esp32p4"
CONFIG_ESP32P4_SELECTS_REV_LESS_V3=y
CONFIG_ESP32P4_REV_MIN_1=y
CONFIG_ESPTOOLPY_FLASHMODE_DIO=y
CONFIG_ESPTOOLPY_FLASHFREQ_40M=y
CONFIG_ESPTOOLPY_FLASHSIZE_16MB=y
CONFIG_PARTITION_TABLE_CUSTOM=y
CONFIG_PARTITION_TABLE_CUSTOM_FILENAME="partitions.csv"
CONFIG_EXAMPLE_ENABLE_CAM_SENSOR_PIC_VFLIP=n
CONFIG_EXAMPLE_ENABLE_CAM_SENSOR_PIC_HFLIP=n
CONFIG_APP_UI_DISP_ROT_180=y
CONFIG_COMPILER_OPTIMIZATION_PERF=y
CONFIG_COMPILER_ORPHAN_SECTIONS_PLACE=y
CONFIG_SPIRAM=y
CONFIG_SPIRAM_SPEED_200M=y
CONFIG_SPIRAM_XIP_FROM_PSRAM=y
CONFIG_SPIRAM_USE_CAPS_ALLOC=y
CONFIG_CACHE_L2_CACHE_256KB=y
CONFIG_CACHE_L2_CACHE_LINE_128B=y
CONFIG_FATFS_LFN_HEAP=y
CONFIG_VFS_MAX_COUNT=20
CONFIG_BSP_LCD_DPI_BUFFER_NUMS=2
# CONFIG_BSP_DISPLAY_LVGL_AVOID_TEAR is not set
# CONFIG_BSP_DISPLAY_LVGL_DIRECT_MODE is not set
CONFIG_ESP_VIDEO_ENABLE_MIPI_CSI_VIDEO_DEVICE=y
CONFIG_ESP_VIDEO_DISABLE_MIPI_CSI_DRIVER_BACKUP_BUFFER=y
# Waveshare ESP32-P4-WIFI6-Touch-LCD-7B：OV5647 MIPI CSI（与 esp_cam_sensor 一致）
CONFIG_CAMERA_OV5647=y
CONFIG_CAMERA_OV5647_AUTO_DETECT=y
CONFIG_CAMERA_OV5647_AUTO_DETECT_MIPI_INTERFACE_SENSOR=y
# Match the official 11_esp_brookesia_phone camera mode; the RAW8 800x1280
# mode is portrait and makes the preview appear vertical on this 7-inch panel.
# CONFIG_CAMERA_OV5647_MIPI_RAW8_800x1280_50FPS is not set
CONFIG_CAMERA_OV5647_MIPI_RAW10_1280x960_BINNING_45FPS=y
CONFIG_CAMERA_OV5647_MIPI_IF_FORMAT_INDEX_DAFAULT=4
CONFIG_CAMERA_OV5647_CSI_LINESYNC_ENABLE=y
CONFIG_CAMERA_OV5647_ISP_AF_ENABLE=y
CONFIG_CAMERA_OV5647_DEFAULT_IPA_JSON_CONFIGURATION_FILE=y
CONFIG_ESP_VIDEO_ENABLE_DVP_VIDEO_DEVICE=n
CONFIG_ESP_VIDEO_ENABLE_ISP_PIPELINE_CONTROLLER=y
# LVGL product UI creates many small objects. Use ESP-IDF heap malloc instead of
# LVGL's default 64KB built-in pool, otherwise labels/buttons can fail to allocate.
# CONFIG_LV_USE_BUILTIN_MALLOC is not set
CONFIG_LV_USE_CLIB_MALLOC=y
CONFIG_LV_FONT_MONTSERRAT_14=y
CONFIG_LV_FONT_MONTSERRAT_16=y
CONFIG_LV_FONT_MONTSERRAT_18=y
CONFIG_LV_FONT_FMT_TXT_LARGE=y
CONFIG_LV_USE_FS_STDIO=y
CONFIG_LV_FS_STDIO_LETTER=83
CONFIG_LV_FS_STDIO_PATH=""
CONFIG_LV_FS_STDIO_CACHE_SIZE=4096
CONFIG_LV_USE_TJPGD=y
# LVGL 9.5 使用 Simsun CJK；Source Han 项在此版本 menu 中不存在，不会进 sdkconfig
CONFIG_BSP_SPIFFS_FORMAT_ON_MOUNT_FAIL=y
CONFIG_DB_SPIFFS=y
CONFIG_ESP_MAIN_TASK_STACK_SIZE=10240
CONFIG_FREERTOS_IDLE_TASK_STACKSIZE=1280
CONFIG_FREERTOS_TIMER_TASK_STACK_DEPTH=1024
CONFIG_ESP_TASK_WDT_TIMEOUT_S=15
# CONFIG_ESP_TASK_WDT_CHECK_IDLE_TASK_CPU1 is not set
CONFIG_IDF_EXPERIMENTAL_FEATURES=y

CONFIG_FLASH_PEDESTRIAN_DETECT_PICO_S8_V1=y
CONFIG_PEDESTRIAN_DETECT_PICO_S8_V1=y
CONFIG_PEDESTRIAN_DETECT_MODEL_IN_FLASH_RODATA=y

CONFIG_PC_POSE_ENABLE=y
CONFIG_PC_POSE_WIFI_SSID="zyntm"
CONFIG_PC_POSE_WIFI_PASSWORD="ZY616161"
CONFIG_PC_POSE_SERVER_URL="http://192.168.43.131:8000/pose"
CONFIG_PC_POSE_SERVER_HOST="192.168.43.131"
CONFIG_PC_POSE_SERVER_PORT=8000
CONFIG_PC_POSE_FRAME_W=192
CONFIG_PC_POSE_FRAME_H=192
CONFIG_PC_POSE_HTTP_TIMEOUT_MS=1000
CONFIG_PC_POSE_WIFI_CONNECT_TIMEOUT_MS=10000
CONFIG_PC_POSE_WIFI_MAX_RETRY=8
CONFIG_PC_POSE_RESPONSE_MAX_BYTES=16384

# ESP32-P4 uses the on-board ESP32-C6 as a Wi-Fi co-processor through ESP-Hosted SDIO.
CONFIG_SLAVE_IDF_TARGET_ESP32C6=y
CONFIG_ESP_HOSTED_CP_TARGET_ESP32C6=y
CONFIG_ESP_HOSTED_P4_DEV_BOARD_FUNC_BOARD=y
CONFIG_ESP_HOSTED_SDIO_HOST_INTERFACE=y
# CONFIG_ESP_HOSTED_SPI_HOST_INTERFACE is not set
# CONFIG_ESP_HOSTED_SPI_HD_HOST_INTERFACE is not set
# CONFIG_ESP_HOSTED_UART_HOST_INTERFACE is not set
CONFIG_ESP_HOSTED_SDIO_4_BIT_BUS=y
CONFIG_ESP_HOSTED_SDIO_CLOCK_FREQ_KHZ=40000
CONFIG_ESP_HOSTED_SDIO_RESET_DELAY_MS=1500
# ESP-Hosted creates several tasks before app_main. Keep their control blocks in
# internal RAM, but place the large task stacks in PSRAM to avoid starving
# FreeRTOS timer/main task allocation during boot.
CONFIG_ESP_HOSTED_DFLT_TASK_FROM_SPIRAM=y
# Keep ESP-Hosted SDIO Tx/Rx buffers in internal DMA memory. PSRAM-backed
# buffers can trip sdmmc_io_write_blocks() DMA validation on ESP32-P4.
# CONFIG_ESP_HOSTED_MEMPOOL_PREFER_SPIRAM is not set
CONFIG_WIFI_RMT_STATIC_RX_BUFFER_NUM=16
CONFIG_WIFI_RMT_DYNAMIC_RX_BUFFER_NUM=64
CONFIG_WIFI_RMT_DYNAMIC_TX_BUFFER_NUM=64
CONFIG_WIFI_RMT_AMPDU_TX_ENABLED=y
CONFIG_WIFI_RMT_TX_BA_WIN=32
CONFIG_WIFI_RMT_AMPDU_RX_ENABLED=y
CONFIG_WIFI_RMT_RX_BA_WIN=32
CONFIG_LWIP_TCP_SND_BUF_DEFAULT=65534
CONFIG_LWIP_TCP_WND_DEFAULT=65534
CONFIG_LWIP_TCP_RECVMBOX_SIZE=64
CONFIG_LWIP_UDP_RECVMBOX_SIZE=64
CONFIG_LWIP_TCPIP_RECVMBOX_SIZE=64
CONFIG_LWIP_TCP_SACK_OUT=y
```

## sdkconfig.defaults.esp32p4
```kconfig
# ESP32-P4 + on-board ESP32-C6 ESP-Hosted host defaults.
CONFIG_SLAVE_IDF_TARGET_ESP32C6=y
CONFIG_ESP_HOSTED_CP_TARGET_ESP32C6=y
CONFIG_ESP_HOSTED_P4_DEV_BOARD_FUNC_BOARD=y
CONFIG_ESP_HOSTED_SDIO_HOST_INTERFACE=y
# CONFIG_ESP_HOSTED_SPI_HOST_INTERFACE is not set
# CONFIG_ESP_HOSTED_SPI_HD_HOST_INTERFACE is not set
# CONFIG_ESP_HOSTED_UART_HOST_INTERFACE is not set
```
